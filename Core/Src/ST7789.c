#include "ST7789.h"

extern SPI_HandleTypeDef hspi1;

static const uint16_t Font7x9[] = {
    0x0000, 0x0000, 0x0000, 0x0000, 0x0000, 0x0000, 0x0000, 0x0000, 0x0000,  // space (32)
    0x1000, 0x1000, 0x1000, 0x1000, 0x1000, 0x1000, 0x0000, 0x1000, 0x0000,  // !
    0x2800, 0x2800, 0x2800, 0x0000, 0x0000, 0x0000, 0x0000, 0x0000, 0x0000,  // "
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    0x0000, 0x0000, 0x0000, 0x0000, 0x0000, 0x0000, 0x0000, 0x0000, 0x0000   // DEL
};

static void WriteCmd(uint8_t cmd) {
    HAL_GPIO_WritePin(TFT_CS_GPIO_Port, TFT_CS_Pin, GPIO_PIN_RESET);
    HAL_GPIO_WritePin(TFT_DC_GPIO_Port, TFT_DC_Pin, GPIO_PIN_RESET);
    HAL_SPI_Transmit(&hspi1, &cmd, 1, HAL_MAX_DELAY);
    HAL_GPIO_WritePin(TFT_CS_GPIO_Port, TFT_CS_Pin, GPIO_PIN_SET);
}

static void WriteData(uint8_t *data, uint16_t size) {
    HAL_GPIO_WritePin(TFT_CS_GPIO_Port, TFT_CS_Pin, GPIO_PIN_RESET);
    HAL_GPIO_WritePin(TFT_DC_GPIO_Port, TFT_DC_Pin, GPIO_PIN_SET);
    HAL_SPI_Transmit(&hspi1, data, size, HAL_MAX_DELAY);
    HAL_GPIO_WritePin(TFT_CS_GPIO_Port, TFT_CS_Pin, GPIO_PIN_SET);
}

static void ST7789_SetAddressWindow(uint16_t x0, uint16_t y0, uint16_t x1, uint16_t y1) {
    WriteCmd(0x2A);
    uint8_t dataX[] = { (x0 >> 8) & 0xFF, x0 & 0xFF, (x1 >> 8) & 0xFF, x1 & 0xFF };
    WriteData(dataX, 4);

    WriteCmd(0x2B);
    uint8_t dataY[] = { (y0 >> 8) & 0xFF, y0 & 0xFF, (y1 >> 8) & 0xFF, y1 & 0xFF };
    WriteData(dataY, 4);

    WriteCmd(0x2C);
}

void ST7789_Init(void) {
    HAL_GPIO_WritePin(TFT_RESET_GPIO_Port, TFT_RESET_Pin, GPIO_PIN_RESET);
    HAL_Delay(50);
    HAL_GPIO_WritePin(TFT_RESET_GPIO_Port, TFT_RESET_Pin, GPIO_PIN_SET);
    HAL_Delay(100);

    WriteCmd(0x01); HAL_Delay(150);
    WriteCmd(0x11); HAL_Delay(120);

    uint8_t colmod = 0x05;
    WriteCmd(0x3A); WriteData(&colmod, 1);

    WriteCmd(0x21);
    WriteCmd(0x29); HAL_Delay(50);
}

void ST7789_FillScreen(uint16_t color) {
    ST7789_SetAddressWindow(0, 0, 239, 239);
    uint8_t color_bytes[2] = { (color >> 8) & 0xFF, color & 0xFF };

    HAL_GPIO_WritePin(TFT_CS_GPIO_Port, TFT_CS_Pin, GPIO_PIN_RESET);
    HAL_GPIO_WritePin(TFT_DC_GPIO_Port, TFT_DC_Pin, GPIO_PIN_SET);

    for (uint32_t i = 0; i < 240 * 240; i++) {
        HAL_SPI_Transmit(&hspi1, color_bytes, 2, HAL_MAX_DELAY);
    }
    HAL_GPIO_WritePin(TFT_CS_GPIO_Port, TFT_CS_Pin, GPIO_PIN_SET);
}

void ST7789_DrawChar(int16_t x, int16_t y, char c, uint16_t color, uint16_t bg, uint8_t size) {
    if (c < 32 || c > 126) return;

    uint16_t char_offset = (c - 32) * 9;
    uint8_t color_bytes[2] = { (color >> 8) & 0xFF, color & 0xFF };
    uint8_t bg_bytes[2]    = { (bg >> 8) & 0xFF, bg & 0xFF };

    ST7789_SetAddressWindow(x, y, x + (7 * size) - 1, y + (9 * size) - 1);

    HAL_GPIO_WritePin(TFT_CS_GPIO_Port, TFT_CS_Pin, GPIO_PIN_RESET);
    HAL_GPIO_WritePin(TFT_DC_GPIO_Port, TFT_DC_Pin, GPIO_PIN_SET);

    for (uint8_t r = 0; r < 9; r++) {
        uint16_t row_data = Font7x9[char_offset + r];

        for (uint8_t sy = 0; sy < size; sy++) {
            for (uint8_t c_idx = 0; c_idx < 7; c_idx++) {
                uint8_t is_pixel = (row_data & (0x8000 >> c_idx)) ? 1 : 0;
                uint8_t *pColor = is_pixel ? color_bytes : bg_bytes;

                for (uint8_t sx = 0; sx < size; sx++) {
                    HAL_SPI_Transmit(&hspi1, pColor, 2, HAL_MAX_DELAY);
                }
            }
        }
    }

    HAL_GPIO_WritePin(TFT_CS_GPIO_Port, TFT_CS_Pin, GPIO_PIN_SET);
}

void ST7789_WriteString(int16_t x, int16_t y, const char *str, uint16_t color, uint16_t bg, uint8_t size) {
    while (*str) {
        ST7789_DrawChar(x, y, *str, color, bg, size);
        x += 7 * size;
        str++;
    }
}
